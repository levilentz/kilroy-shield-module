## boards/shields/kilroy/Kconfig.defconfig
```kconfig
CONFIG_ZMK_SLEEP=y
CONFIG_ZMK_PM_SOFT_OFF=y

if SHIELD_KILROY_LEFT

config ZMK_KEYBOARD_NAME
    default "Kilroy"

config ZMK_SPLIT_BLE_ROLE_CENTRAL
    default y
    
config ZMK_SPLIT_ROLE_CENTRAL
    default y

endif

if SHIELD_KILROY_LEFT || SHIELD_KILROY_RIGHT

config ZMK_SPLIT
    default y

endif
```

## boards/shields/kilroy/Kconfig.shield
```kconfig
config SHIELD_KILROY_DONGLE
    def_bool $(shields_list_contains,kilroy_dongle)

config SHIELD_KILROY_LEFT
    def_bool $(shields_list_contains,kilroy_left)

config SHIELD_KILROY_RIGHT
    def_bool $(shields_list_contains,kilroy_right)
```
